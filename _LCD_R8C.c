//*************************************************************************************************//
//*************************************************************************************************//
//-------------------------------------------- 16X2 LCD -------------------------------------------//
//*************************************************************************************************//
//*************************************************************************************************//


//-------------------------------------------------------------------------------------------------//
//-------------------------------- Variables & Functions Declaration ------------------------------//
//-------------------------------------------------------------------------------------------------//
sbit rs=P1^0;
sbit en=P1^1;

#define lcd_port P0     							// Dataport of LCD-Display (D0..D7) to Port P0(P0..P7)

void lcd_delay();
void lcd_init(void);                        		// Initialize the LCD display
void lcd_cginit(void);                        		// Initialize the Custom Graphics in LCD display
void lcd_clear(void);								// Clear LCD
void lcd_command(char cmd);		    				// Send LCD Command
void lcd_gotoxy(char x,char y);						// Goto X,Y position in the LCD display
void lcd_putchar(char value);  						// Writes a character to display
void lcd_printxy(char x,char y,char *text);
void lcd_print_b(char val_a);


//-------------------------------------------------------------------------------------------------//
//----------------------------------------- Delay Routine -----------------------------------------//
//-------------------------------------------------------------------------------------------------//

void lcd_delay()
{
	unsigned char a;
	a=255;
	while(a--);
	a=255;
	while(a--);
}

//-------------------------------------------------------------------------------------------------//
//-------------------------------------- LCD Initialisation ---------------------------------------//
//-------------------------------------------------------------------------------------------------//

void lcd_init(void)
{
   en=0;
   lcd_command(20);
   lcd_command(0x30);
   delay_ms(5);
   lcd_command(0x30);
   lcd_command(0xc0);
   lcd_command(0x38); //initialization of 16x2 LCD in 8bit mode
   lcd_command(0x08);
   lcd_clear();
   lcd_command(0x06);
   lcd_command(0x0e);
   lcd_command(0x0C);
}

//-------------------------------------------------------------------------------------------------//
//------------------------------------------- LCD Clear -------------------------------------------//
//-------------------------------------------------------------------------------------------------//

void lcd_clear(void)
{
	lcd_command(0x01);
	lcd_delay();
	lcd_delay();
	lcd_delay();
}

//-------------------------------------------------------------------------------------------------//
//--------------------------------------- LCD Send Command ----------------------------------------//
//-------------------------------------------------------------------------------------------------//

void lcd_command(unsigned char cmd)
{
   lcd_port=cmd;
   rs=0;
   en=1;
   en=0;
   lcd_delay();                     				// Wait 400µs
}

//-------------------------------------------------------------------------------------------------//
//----------------------------------------- LCD Goto X,Y ------------------------------------------//
//-------------------------------------------------------------------------------------------------//

void lcd_gotoxy(unsigned char x,unsigned char y)
{
   	//if((x<1||x>2)) 								// if((x<1||x>2)&&(y<1||y>16))
	if(x>2)
	{
		x=1; 										// x=1; y=1;
	}
	if(x == 1)
		lcd_command(0x7F+y);
	else
		lcd_command(0xBF+y);
}

//-------------------------------------------------------------------------------------------------//
//---------------------------------------- LCD Print Text -----------------------------------------//
//-------------------------------------------------------------------------------------------------//


void lcd_putchar(unsigned char value)
{
	lcd_port=value;
  rs=1;
  en=1;
  en=0;
	lcd_delay();                     				// Wait 400µs
} 

//-------------------------------------------------------------------------------------------------//

void lcd_printxy(unsigned char x,unsigned char y, unsigned char *text)
{
	lcd_gotoxy(x,y);            						// Set cursor position
	while(*text)          								// while not end of text
	{
		lcd_putchar(*text); 							    // Write character and increment position
	  text++;
	} 
}

//-------------------------------------------------------------------------------------------------//
//------------------------------- Writing 8- Value to LCD --------------------------------------//
//-------------------------------------------------------------------------------------------------//

void lcd_print_b(unsigned char val_a)
{
	unsigned char temp_a;
							   						// 123
	temp_a = val_a/100;				 				// 123 / 100 = 1
	if(temp_a!=0)
	{
		lcd_putchar(temp_a+0x30);
	}
	temp_a = val_a/10;	   							// 123 / 10 = 12
	temp_a = temp_a%10;								// 12 % 10 = 2
	lcd_putchar(temp_a+0x30);
	temp_a = val_a%10;								// 123 % 10 = 3
	lcd_putchar(temp_a+0x30);
}

